/**
 * @cliArgs --device "AM62x" --package "ALW" --part "Default" --context "m4fss0-0" --product "MCU_PLUS_SDK_AM62x@08.05.00"
 * @versions {"tool":"1.15.0+2826"}
 */

/**
 * Import the modules used in this configuration.
 */
const gpio            = scripting.addModule("/drivers/gpio/gpio", {}, false);
const gpio1           = gpio.addInstance();
const ipc             = scripting.addModule("/drivers/ipc/ipc");
const mcspi           = scripting.addModule("/drivers/mcspi/mcspi", {}, false);
const mcspi1          = mcspi.addInstance();
const addr_translate  = scripting.addModule("/kernel/dpl/addr_translate", {}, false);
const addr_translate1 = addr_translate.addInstance();
const addr_translate2 = addr_translate.addInstance();
const addr_translate3 = addr_translate.addInstance();
const addr_translate4 = addr_translate.addInstance();
const addr_translate5 = addr_translate.addInstance();
const addr_translate6 = addr_translate.addInstance();
const clock           = scripting.addModule("/kernel/dpl/clock");
const debug_log       = scripting.addModule("/kernel/dpl/debug_log");
const mpu_armv7       = scripting.addModule("/kernel/dpl/mpu_armv7", {}, false);
const mpu_armv71      = mpu_armv7.addInstance();
const mpu_armv72      = mpu_armv7.addInstance();
const timer           = scripting.addModule("/kernel/dpl/timer", {}, false);
const timer1          = timer.addInstance();

/**
 * Write custom configuration values to the imported modules.
 */
gpio1.$name                    = "AM62_R_ENABLE";
gpio1.pinDir                   = "OUTPUT";
gpio1.MCU_GPIO.$assign         = "MCU_GPIO0";
gpio1.MCU_GPIO.gpioPin.pu_pd   = "pu";
gpio1.MCU_GPIO.gpioPin.$assign = "ball.B3";

ipc.r5fss0_0 = "NONE";

mcspi1.$name                           = "ADC_SPI";
mcspi1.transferMode                    = "CALLBACK";
mcspi1.transferCallbackFxn             = "adc_spi_cb";
mcspi1.inputSelect                     = "0";
mcspi1.dpe0                            = "DISABLE";
mcspi1.dpe1                            = "ENABLE";
mcspi1.MCU_SPI.$assign                 = "MCU_SPI0";
mcspi1.MCU_SPI.CLK.$assign             = "ball.A7";
mcspi1.MCU_SPI.D0.$assign              = "ball.D9";
mcspi1.MCU_SPI.D1.$assign              = "ball.C9";
mcspi1.mcspiChannel[0].$name           = "CONFIG_MCSPI_CH0";
mcspi1.mcspiChannel[0].advanced        = true;
mcspi1.mcspiChannel[0].frameFormat     = "POL1_PHA1";
mcspi1.mcspiChannel[0].bitRate         = 800000;
mcspi1.mcspiChannel[0].MCU_CSn.$assign = "ball.B8";

addr_translate1.$name     = "CONFIG_ADDR_TRANSLATE_REGION0";
addr_translate1.localAddr = 0x80000000;
addr_translate1.size      = 28;

addr_translate2.$name      = "CONFIG_ADDR_TRANSLATE_REGION1";
addr_translate2.localAddr  = 0x90000000;
addr_translate2.systemAddr = 0x90000000;
addr_translate2.size       = 28;

addr_translate3.$name      = "CONFIG_ADDR_TRANSLATE_REGION2";
addr_translate3.size       = 28;
addr_translate3.localAddr  = 0xA0000000;
addr_translate3.systemAddr = 0xA0000000;

addr_translate4.$name      = "CONFIG_ADDR_TRANSLATE_REGION3";
addr_translate4.size       = 28;
addr_translate4.localAddr  = 0xB0000000;
addr_translate4.systemAddr = 0x20000000;

addr_translate5.$name      = "CONFIG_ADDR_TRANSLATE_REGION4";
addr_translate5.localAddr  = 0xC0000000;
addr_translate5.size       = 28;
addr_translate5.systemAddr = 0x30000000;

addr_translate6.$name      = "CONFIG_ADDR_TRANSLATE_REGION5";
addr_translate6.localAddr  = 0xD0000000;
addr_translate6.size       = 28;
addr_translate6.systemAddr = 0x40000000;

debug_log.enableUartLog = true;
debug_log.uartLog.$name = "CONFIG_UART0";

mpu_armv71.$name        = "CONFIG_MPU_REGION0";
mpu_armv71.attributes   = "Device";
mpu_armv71.allowExecute = false;

mpu_armv72.$name = "CONFIG_MPU_REGION1";
mpu_armv72.size  = 18;

timer1.timerCallback     = "pwm_timer_overflow";
timer1.$name             = "PWM_TIMER";
timer1.enableIntr        = false;
timer1.MCU_TIMER.$assign = "MCU_DMTIMER2";

/**
 * Pinmux solution for unlocked pins/peripherals. This ensures that minor changes to the automatic solver in a future
 * version of the tool will not impact the pinmux you originally saw.  These lines can be completely deleted in order to
 * re-solve from scratch.
 */
debug_log.uartLog.MCU_UART.$suggestSolution     = "MCU_USART0";
debug_log.uartLog.MCU_UART.RXD.$suggestSolution = "ball.B5";
debug_log.uartLog.MCU_UART.TXD.$suggestSolution = "ball.A5";
