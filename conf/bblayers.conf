## conf/bblayers.conf
```bitbake
# POKY_BBLAYERS_CONF_VERSION is increased each time build/conf/bblayers.conf
# changes incompatibly
POKY_BBLAYERS_CONF_VERSION = "2"

BBPATH = "${TOPDIR}"
BBFILES ?= ""

OEROOT := "${@os.path.abspath(os.path.dirname(d.getVar('FILE', True)) + '/../../sources/poky')}"
# add BSPDIR variable, as it is needed by recipes of NXP
BSPDIR := "${OEROOT}/../.."

# In our BSPs active layers are defined by the manifest.xml for all BSPs. The
# bblayers.conf gets created by the init_bblayers.py script.
BBLAYERS ?= ""
BBLAYERS += "\
  ${OEROOT}/../meta-phytec \
  ${OEROOT}/../meta-qt5-phytec \
  ${OEROOT}/../meta-ampliphy \
  ${OEROOT}/../meta-summit-radio/meta-summit-radio \
  ${OEROOT}/../poky/meta \
  ${OEROOT}/../poky/meta-poky \
  ${OEROOT}/../meta-openembedded/meta-oe \
  ${OEROOT}/../meta-openembedded/meta-networking \
  ${OEROOT}/../meta-openembedded/meta-python \
  ${OEROOT}/../meta-openembedded/meta-gnome \
  ${OEROOT}/../meta-openembedded/meta-multimedia \
  ${OEROOT}/../meta-openembedded/meta-filesystems \
  ${OEROOT}/../meta-openembedded/meta-perl \
  ${OEROOT}/../meta-rauc \
  ${OEROOT}/../meta-arm/meta-arm \
  ${OEROOT}/../meta-arm/meta-arm-toolchain \
  ${OEROOT}/../meta-qt5 \
  ${OEROOT}/../meta-ti/meta-ti-bsp \
  ${OEROOT}/../meta-ti/meta-ti-extras \
  ${OEROOT}/../meta-virtualization \
  ${OEROOT}/../meta-security/meta-tpm \
  ${OEROOT}/../meta-everest \
  ${OEROOT}/../meta-ti-evse \
  "
```

## conf/layer.conf
```bitbake
# We have a conf and classes directory, add to BBPATH
BBPATH .= ":${LAYERDIR}"

# We have recipes-* directories, add to BBFILES
BBFILES += "${LAYERDIR}/recipes-*/*/*.bb \
            ${LAYERDIR}/recipes-*/*/*.bbappend"

BBFILE_COLLECTIONS += "ti-evse"
BBFILE_PATTERN_ti-evse = "^${LAYERDIR}/"

LAYERDEPENDS_ti-evse = "meta-ti-bsp"
LAYERSERIES_COMPAT_ti-evse = "kirkstone"

BBFILES_DYNAMIC += " \
	meta-ti-bsp:${LAYERDIR}/dynamic-layers/meta-ti/recipes-*/*/*.bb \
        meta-ti-bsp:${LAYERDIR}/dynamic-layers/meta-ti/recipes-*/*/*.bbappend \
"
```

## conf/machine/phyboard-lyra-am62xx-k3r5.conf
```bitbake
require conf/machine/include/k3r5.inc

SYSFW_SOC = "am62x"
SYSFW_CONFIG = "evm"
SYSFW_SUFFIX = "gp"

UBOOT_MACHINE = "phycore_am62x_r5_defconfig"

PREFERRED_PROVIDER_virtual/kernel = "linux-dummy"
PREFERRED_PROVIDER_virtual/bootloader = "u-boot-ti"
```

## conf/machine/phyboard-lyra-am62xx.conf
```bitbake
require conf/machine/include/am62xx.inc
include conf/machine/include/phyam62xx.inc

MACHINE_FEATURES += "can emmc gpu wifi"

KERNEL_DEVICETREE = " \
    ti/k3-am625-phyboard-lyra-rdk.dtb \
    ti/k3-am62-phyboard-lyra-oldi-lcd185.dtbo \
    ti/k3-am62-phyboard-lyra-vm016-mipi.dtbo \
    ti/k3-am62-phyboard-lyra-m2-wifi.dtbo \
"

KERNEL_IMAGETYPE = "Image"
KERNEL_IMAGETYPES = "Image vmlinux.gz"

PREFERRED_PROVIDER_virtual/kernel:${MACHINE} = "linux-ti"
PREFERRED_PROVIDER_virtual/bootloader:${MACHINE} = "u-boot-ti"

UBOOT_MACHINE = "phycore_am62x_a53_defconfig"

WKS_FILE = "sdimage-2part.wks"
```
